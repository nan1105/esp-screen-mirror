## sdkconfig.defaults
```kconfig
CONFIG_TINYUSB_CDC_ENABLED=y
CONFIG_TINYUSB_CDC_COUNT=1
CONFIG_TINYUSB_CDC_RX_BUFSIZE=4096
CONFIG_TINYUSB_CDC_TX_BUFSIZE=512
CONFIG_TINYUSB_CDC_EP_BUFSIZE=512

# Disable USB Serial/JTAG to free GPIO 19/20 for USB OTG
CONFIG_USJ_ENABLE_USB_SERIAL_JTAG=n

# Disable brownout detector (USB power insufficient during WiFi init)
CONFIG_ESP_BROWNOUT_DET=n
```
